## conf/distro/cacao.conf
```bitbake
require conf/distro/poky.conf

DISTRO = "cacao"
DISTRO_CODENAME = "cacao"
DISTRO_NAME = "Cacao"

SDK_VENDOR = "-chik"
TARGET_VENDOR = ""

# Features
DISTRO_FEATURES="\
    ipv4 \
    ipv6 \
    libc-backtrace \
    libc-big-macros \
    libc-bsd \
    libc-catgets \
    libc-charsets \
    libc-crypt \
    libc-crypt-ufc \
    libc-cxx-tests \
    libc-db-aliases \
    libc-envz \
    libc-fcvt \
    libc-fmtmsg \
    libc-fstab \
    libc-ftraverse \
    libc-getlogin \
    libc-idn \
    libc-inet-anl \
    libc-libm \
    libc-locale-code \
    libc-locales \
    libc-memusage \
    libc-nis \
    libc-nsswitch \
    libc-posix-clang-wchar \
    libc-posix-regexp \
    libc-posix-regexp-glibc \
    libc-posix-wchar-io \
    libc-rcmd \
    libc-rtld-debug \
    libc-spawn \
    libc-streams \
    libc-sunrpc \
    libc-utmp \
    libc-utmpx \
    libc-wordexp \
    systemd \
    wifi \
    "

# systemd
DISTRO_FEATURES_BACKFILL_CONSIDERED = "sysvinit"
VIRTUAL-RUNTIME_init_manager = "systemd"
VIRTUAL-RUNTIME_initscripts = "systemd-compat-units"
VIRTUAL-RUNTIME_syslog = ""

# vt
SYSVINIT_ENABLED_GETTYS = ""
USE_VT = "0"
```

## conf/machine/rpi-0w.conf
```bitbake
#@TYPE: Machine
#@NAME: RaspberryPi Zero WiFi
#@DESCRIPTION: Machine configuration for the RaspberryPi Zero  WiFi board (https://www.raspberrypi.org/blog/raspberry-pi-zero-w-joins-family/)

include conf/machine/raspberrypi0-wifi.conf

KBUILD_DEFCONFIG = "bcmrpi_defconfig"
RPI_KERNEL_DEVICETREE = "bcm2708-rpi-0-w.dtb"

PREFERRED_PROVIDER_virtual/kernel = "linux-raspberrypi"
PREFERRED_PROVIDER_virtual/xserver = ""
PREFERRED_PROVIDER_virtual/egl = ""
PREFERRED_PROVIDER_virtual/libgles2 = ""
PREFERRED_PROVIDER_virtual/libgl = ""
PREFERRED_PROVIDER_virtual/mesa = ""
PREFERRED_PROVIDER_virtual/libgbm = ""
PREFERRED_PROVIDER_jpeg = ""

IMAGE_FSTYPES = "ext3 rpi-sdimg wic"
WKS_FILE = "chik-partitions.wks"
SERIAL_CONSOLES = ""
```

## conf/machine/rpi-0w_music.conf
```bitbake
#@TYPE: Machine
#@NAME: RaspberryPi Zero WiFi
#@DESCRIPTION: Machine configuration for the RaspberryPi Zero  WiFi board (https://www.raspberrypi.org/blog/raspberry-pi-zero-w-joins-family/)

include conf/machine/raspberrypi0-wifi.conf

KBUILD_DEFCONFIG = "bcmrpi_defconfig"
KERNEL_DEVICETREE = "bcm2708-rpi-zero-w-music.dtb"

PREFERRED_PROVIDER_virtual/kernel = "linux-raspberrypi"
PREFERRED_PROVIDER_virtual/xserver = ""
PREFERRED_PROVIDER_virtual/egl = ""
PREFERRED_PROVIDER_virtual/libgles2 = ""
PREFERRED_PROVIDER_virtual/libgl = ""
PREFERRED_PROVIDER_virtual/mesa = ""
PREFERRED_PROVIDER_virtual/libgbm = ""
PREFERRED_PROVIDER_jpeg = ""

RPI_USE_U_BOOT = "1"
ENABLE_UART="1"
IMAGE_FSTYPES = "ext4.gz wic"
UBOOT_MACHINE = "rpi_0_w_defconfig"
WKS_FILE = "chik-music-partitions.wks"
SERIAL_CONSOLES = "115200;ttyS0"
```

## wic/chik-partitions.wks
```
# short-description: Create Raspberry Pi SD card image
# long-description: Creates a partitioned SD card image for use with
# Raspberry Pi. Boot files are located in the first vfat partition.

part /boot --source bootimg-partition --ondisk mmcblk0 --fstype=vfat --label boot --active --align 4096 --size 20
part / --source rootfs --ondisk mmcblk0 --fstype=ext4  --label root --align 4096
part /etc --source rootfs --sourceparams="subdir=/etc" --fsoptions="rw,async,noatime" --ondisk mmcblk0 --fstype=ext4 --label conf --align 4096 --size 10M
```
